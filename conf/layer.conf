## conf/layer.conf
```bitbake
# We have a conf and classes directory, append to BBPATH
BBPATH .= ":${LAYERDIR}"

# We have a recipes directory containing .bb and .bbappend files, add to BBFILES
BBFILES += "${LAYERDIR}/recipes-*/*/*.bb \
            ${LAYERDIR}/recipes-*/*/*.bbappend"

BBFILE_COLLECTIONS += "compulab-bsp-imx6"
BBFILE_PATTERN_compulab-bsp-imx6 := "^${LAYERDIR}/"
BBFILE_PRIORITY_compulab-bsp-imx6 = "9"

BBMASK += "meta-compulab/recipes-xfce"
BBMASK += "meta-compulab/recipes-browser"
BBMASK += "recipes-core/initscripts/initscripts_1.0.bbappend"

LAYERSERIES_COMPAT_compulab-bsp-imx6 = "sumo zeus warrior"

HOSTTOOLS += " git-lfs "
HOSTTOOLS += " bison "

IMAGE_INSTALL_append += " kernel-devicetree kernel-modules "

PREFERRED_VERSION_u-boot-compulab = "2015.07.01"
PREFERRED_VERSION_linux-compulab = "${@bb.utils.contains('DISTRO_CODENAME', 'warrior', '4.19.35', '4.14.98', d)}"
BBMASK += "${@bb.utils.contains('DISTRO_CODENAME', 'warrior', 'linux-compulab_4.14.98.bb*', '', d)}"
```

## conf/machine/cl-som-imx6.conf
```bitbake
#@TYPE: Machine
#@NAME: CompuLab CL-SOM-iMX6
#@SOC: i.MX6 Q
#@DESCRIPTION: Machine configuration for CompuLab CL-SOM-iMX6 machines
#@MAINTAINER: Valentin Raevsky <valentin@compulab.co.il>

require conf/machine/include/imx-base.inc
require conf/machine/include/tune-cortexa9.inc

SOC_FAMILY = "mx6:mx6q"
MACHINEOVERRIDES =. "mx6:mx6q:"

PREFERRED_PROVIDER_u_boot_cl-som-imx6 = "u-boot-compulab"
PREFERRED_PROVIDER_virtual/bootloader_cl-som-imx6 = "u-boot-compulab"
PREFERRED_PROVIDER_virtual/kernel_cl-som-imx6 = "linux-compulab"

do_rootfs[depends] += "u-boot-script-compulab:do_deploy"

BOOT_SCRIPTS = "boot.scr-${MACHINE}:boot.scr"

UBOOT_MACHINE ?= "cl_som_imx6_defconfig"
UBOOT_CONFIG[sd] = "cl_som_imx6_defconfig,sdcard"

IMAGE_FSTYPES = "${@bb.utils.contains('DISTRO_CODENAME', 'warrior', 'wic.bmap wic.xz', 'sdcard.xz', d)}"
IMAGE_FSTYPES += "tar.xz"

KERNEL_DEVICETREE = " \
	compulab/imx6q-cl-som-imx6.dtb \
	compulab/imx6qp-cl-som-imx6.dtb \
	compulab/imx6qp-sbc-imx6.dtb \
	compulab/imx6qp-sbc-imx6-hdmi.dtb \
	compulab/imx6q-sbc-imx6.dtb \
	compulab/imx6q-sbc-imx6-hdmi.dtb \
	compulab/imx6q-sbc-imx6-wvga.dtb \
	compulab/imx6qp-sbc-imx6-wvga.dtb \
"

IMAGE_BOOT_FILES = "zImage boot.scr "
IMAGE_BOOT_FILES += " \
	imx6q-cl-som-imx6.dtb \
	imx6qp-cl-som-imx6.dtb \
	imx6qp-sbc-imx6.dtb \
	imx6qp-sbc-imx6-hdmi.dtb \
	imx6q-sbc-imx6.dtb \
	imx6q-sbc-imx6-hdmi.dtb \
	imx6q-sbc-imx6-wvga.dtb \
	imx6qp-sbc-imx6-wvga.dtb \
"

MACHINE_FEATURES += "pci wifi bluetooth alsa bluetooth serial usbhost wifi"

MACHINE_FIRMWARE_append_cl-som-imx6 += "firmware-brcm linux-firmware-bcm43430"

SERIAL_CONSOLE = "115200 ttymxc3"

PREFERRED_VERSION_u-boot-compulab_cl-som-imx6 = "2015.07.01"
PREFERRED_VERSION_linux-compulab_cl-som-imx6 = "${@bb.utils.contains('DISTRO_CODENAME', 'warrior', '4.19.35', '4.14.98', d)}"
```

## conf/machine/cl-som-imx6ul.conf
```bitbake
#@TYPE: Machine
#@NAME: CompuLab CL-SOM-iMX6UL
#@SOC: i.MX6UL
#@DESCRIPTION: Machine configuration for CompuLab CL-SOM-iMX6UL machines
#@MAINTAINER: Valentin Raevsky <valentin@compulab.co.il>

require conf/machine/include/imx-base.inc
require conf/machine/include/tune-cortexa7.inc

MACHINEOVERRIDES =. "mx6:mx6ul:"

PREFERRED_PROVIDER_u_boot_cl-som-imx6ul = "u-boot-compulab"
PREFERRED_PROVIDER_virtual/bootloader_cl-som-imx6ul = "u-boot-compulab"
PREFERRED_PROVIDER_virtual/kernel_cl-som-imx6ul = "linux-compulab"

do_rootfs[depends] += "u-boot-script-compulab:do_deploy"

BOOT_SCRIPTS = "boot.scr-${MACHINE}:boot.scr"

UBOOT_MACHINE ?= "cl_som_imx6ul_defconfig"
UBOOT_CONFIG[sd] = "cl_som_imx6ul_defconfig,sdcard"

IMAGE_FSTYPES = "${@bb.utils.contains('DISTRO_CODENAME', 'warrior', 'wic.bmap wic.xz', 'sdcard.xz', d)}"
IMAGE_FSTYPES += "tar.xz"

KERNEL_DEVICETREE = " \
    compulab/imx6ul-cl-som-imx6ul.dtb \
    compulab/imx6ul-cl-som-imx6ul-wilink.dtb \
    compulab/imx6ul-sbc-imx6ul.dtb \
    compulab/imx6ul-sbc-imx6ul-wilink.dtb \
"

IMAGE_BOOT_FILES = "zImage boot.scr "
IMAGE_BOOT_FILES += " \
    imx6ul-cl-som-imx6ul.dtb \
    imx6ul-cl-som-imx6ul-wilink.dtb \
    imx6ul-sbc-imx6ul.dtb \
    imx6ul-sbc-imx6ul-wilink.dtb \
"

MACHINE_FEATURES += "alsa bluetooth serial usbhost wifi"

MACHINE_FIRMWARE = "linux-firmware-wl18xx"

SERIAL_CONSOLE = "115200 ttymxc2"

PREFERRED_VERSION_u-boot-compulab_cl-som-imx6ul = "2015.10"
PREFERRED_VERSION_linux-compulab_cl-som-imx6ul = "4.19.35"
```

## conf/machine/cm-fx6-evk.conf
```bitbake
#@TYPE: Machine
#@NAME: CompuLab CM-FX6
#@SOC: i.MX6 Q
#@DESCRIPTION: Machine configuration for CompuLab CM-FX6 machines
#@MAINTAINER: Valentin Raevsky <valentin@compulab.co.il>

require conf/machine/include/imx-base.inc
require conf/machine/include/tune-cortexa9.inc

SOC_FAMILY = "mx6:mx6q"
MACHINEOVERRIDES =. "mx6:mx6q:"

PREFERRED_PROVIDER_u_boot_cm-fx6-evk = "u-boot-compulab"
PREFERRED_PROVIDER_virtual/bootloader_cm-fx6-evk = "u-boot-compulab"
PREFERRED_PROVIDER_virtual/kernel_cm-fx6-evk = "linux-compulab"

do_rootfs[depends] += "u-boot-script-compulab:do_deploy"

BOOT_SCRIPTS = "boot.scr-${MACHINE}:boot.scr"

UBOOT_MACHINE ?= "cm_fx6_defconfig"
UBOOT_CONFIG[sd] = "cm_fx6_defconfig,sdcard"

IMAGE_FSTYPES = "${@bb.utils.contains('DISTRO_CODENAME', 'warrior', 'wic.bmap wic.xz', 'sdcard.xz', d)}"
IMAGE_FSTYPES += "tar.xz"

KERNEL_DEVICETREE = " \
	compulab/imx6dl-sbc-fx6.dtb \
	compulab/imx6dl-sbc-fx6-hdmi.dtb \
	compulab/imx6q-sbc-fx6.dtb \
	compulab/imx6q-sbc-fx6-hdmi.dtb \
"

IMAGE_BOOT_FILES = "zImage boot.scr "
IMAGE_BOOT_FILES += " \
	imx6dl-sbc-fx6.dtb \
	imx6dl-sbc-fx6-hdmi.dtb \
	imx6q-sbc-fx6.dtb \
	imx6q-sbc-fx6-hdmi.dtb \
"

MACHINE_FEATURES += "pci wifi bluetooth alsa bluetooth serial usbhost wifi"

MACHINE_FIRMWARE_append_cm-fx6-evk += "linux-firmware-sd8787"

SERIAL_CONSOLE = "115200 ttymxc3"

PREFERRED_VERSION_u-boot-compulab_cm-fx6-evk = "2015.07"
```

## meta-b2q/conf/layer.conf
```bitbake
# We have a conf and classes directory, append to BBPATH
BBPATH .= ":${LAYERDIR}"

# We have a recipes directory containing .bb and .bbappend files, add to BBFILES
BBFILES += "${LAYERDIR}/recipes-*/*/*.bb \
            ${LAYERDIR}/recipes-*/*/*.bbappend"

BBFILE_COLLECTIONS += "compulab-bsp-imx6-b2q"
BBFILE_PATTERN_compulab-bsp-imx6-b2q := "^${LAYERDIR}/"
BBFILE_PRIORITY_compulab-bsp-imx6-b2q = "9"

LAYERSERIES_COMPAT_compulab-bsp-imx6-b2q = "sumo zeus"
```
